## meta-attestation/conf/layer.conf
```bitbake
# We have a conf and classes directory, append to BBPATH
BBPATH .= ":${LAYERDIR}"

# We have a recipes directory, add to BBFILES
BBFILES += "${LAYERDIR}/recipes*/*/*.bb ${LAYERDIR}/recipes*/*/*.bbappend"

BBFILE_COLLECTIONS += "attestation"
BBFILE_PATTERN_attestation := "^${LAYERDIR}/"
BBFILE_PRIORITY_attestation = "20"
LAYERVERSION_attestation = "1"
LAYERSERIES_COMPAT_attestation = "scarthgap"
```

## meta-geth/conf/layer.conf
```bitbake
# We have a conf and classes directory, append to BBPATH
BBPATH .= ":${LAYERDIR}"

# We have a recipes directory, add to BBFILES
BBFILES += "${LAYERDIR}/recipes*/*/*.bb ${LAYERDIR}/recipes*/*/*.bbappend"

BBFILE_COLLECTIONS += "geth"
BBFILE_PATTERN_geth := "^${LAYERDIR}/"
BBFILE_PRIORITY_geth = "20"
LAYERVERSION_geth = "1"
LAYERSERIES_COMPAT_geth = "scarthgap"
```

## meta-json-config/conf/layer.conf
```bitbake
# We have a conf and classes directory, append to BBPATH
BBPATH .= ":${LAYERDIR}"

# We have a recipes directory, add to BBFILES
BBFILES += "${LAYERDIR}/recipes*/*/*.bb ${LAYERDIR}/recipes*/*/*.bbappend"

BBFILE_COLLECTIONS += "json-config"
BBFILE_PATTERN_json-config := "^${LAYERDIR}/"
BBFILE_PRIORITY_json-config = "20"
LAYERVERSION_json-config = "1"
LAYERSERIES_COMPAT_json-config = "scarthgap"
```

## meta-lighthouse-bin/conf/layer.conf
```bitbake
# We have a conf and classes directory, append to BBPATH
BBPATH .= ":${LAYERDIR}"

# We have a recipes directory, add to BBFILES
BBFILES += "${LAYERDIR}/recipes*/*/*.bb ${LAYERDIR}/recipes*/*/*.bbappend"

BBFILE_COLLECTIONS += "lighthouse-bin"
BBFILE_PATTERN_lighthouse-bin := "^${LAYERDIR}/"
BBFILE_PRIORITY_lighthouse-bin = "20"
LAYERVERSION_lighthouse-bin = "1"
LAYERSERIES_COMPAT_lighthouse-bin = "scarthgap"
```

## meta-metrics/conf/layer.conf
```bitbake
# We have a conf and classes directory, append to BBPATH
BBPATH .= ":${LAYERDIR}"

# We have a recipes directory, add to BBFILES
BBFILES += "${LAYERDIR}/recipes*/*/*.bb ${LAYERDIR}/recipes*/*/*.bbappend"

BBFILE_COLLECTIONS += "metrics"
BBFILE_PATTERN_metrics := "^${LAYERDIR}/"
BBFILE_PRIORITY_metrics = "20"
LAYERVERSION_metrics = "1"
LAYERSERIES_COMPAT_metrics = "scarthgap"
```

## meta-nethermind/conf/layer.conf
```bitbake
# We have a conf and classes directory, append to BBPATH
BBPATH .= ":${LAYERDIR}"

# We have a recipes directory, add to BBFILES
BBFILES += "${LAYERDIR}/recipes*/*/*.bb ${LAYERDIR}/recipes*/*/*.bbappend"

BBFILE_COLLECTIONS += "nethermind"
BBFILE_PATTERN_nethermind := "^${LAYERDIR}/"
BBFILE_PRIORITY_nethermind = "30"
LAYERVERSION_nethermind = "1"
LAYERSERIES_COMPAT_nethermind = "scarthgap"
```

## meta-raiko-bin/conf/layer.conf
```bitbake
# We have a conf and classes directory, append to BBPATH
BBPATH .= ":${LAYERDIR}"

# We have a recipes directory, add to BBFILES
BBFILES += "${LAYERDIR}/recipes*/*/*.bb ${LAYERDIR}/recipes*/*/*.bbappend"

BBFILE_COLLECTIONS += "raiko-bin"
BBFILE_PATTERN_raiko-bin := "^${LAYERDIR}/"
BBFILE_PRIORITY_raiko-bin = "20"
LAYERVERSION_raiko-bin = "1"
LAYERSERIES_COMPAT_raiko-bin = "scarthgap"
```

## meta-reth/conf/layer.conf
```bitbake
# We have a conf and classes directory, append to BBPATH
BBPATH .= ":${LAYERDIR}"

# We have a recipes directory, add to BBFILES
BBFILES += "${LAYERDIR}/recipes*/*/*.bb ${LAYERDIR}/recipes*/*/*.bbappend"

BBFILE_COLLECTIONS += "reth"
BBFILE_PATTERN_reth := "^${LAYERDIR}/"
BBFILE_PRIORITY_reth = "20"
LAYERVERSION_reth = "1"
LAYERSERIES_COMPAT_reth = "scarthgap"
```

## meta-taiko-client/conf/layer.conf
```bitbake
# We have a conf and classes directory, append to BBPATH
BBPATH .= ":${LAYERDIR}"

# We have a recipes directory, add to BBFILES
BBFILES += "${LAYERDIR}/recipes*/*/*.bb ${LAYERDIR}/recipes*/*/*.bbappend"

BBFILE_COLLECTIONS += "taiko-client"
BBFILE_PATTERN_taiko-client := "^${LAYERDIR}/"
BBFILE_PRIORITY_taiko-client = "20"
LAYERVERSION_taiko-client = "1"
LAYERSERIES_COMPAT_taiko-client = "scarthgap"
```

## meta-tdx-attestor/conf/layer.conf
```bitbake
# We have a conf and classes directory, append to BBPATH
BBPATH .= ":${LAYERDIR}"

# We have a recipes directory, add to BBFILES
BBFILES += "${LAYERDIR}/recipes*/*/*.bb ${LAYERDIR}/recipes*/*/*.bbappend"

BBFILE_COLLECTIONS += "tdx-attestor"
BBFILE_PATTERN_tdx-attestor := "^${LAYERDIR}/"
BBFILE_PRIORITY_tdx-attestor = "20"
LAYERVERSION_tdx-attestor = "1"
LAYERSERIES_COMPAT_tdx-attestor = "scarthgap"
```
